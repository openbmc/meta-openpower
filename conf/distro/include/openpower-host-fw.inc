## conf/distro/include/openpower-host-fw.inc
```bitbake
VERSION_PURPOSE = "xyz.openbmc_project.Software.Version.VersionPurpose.System"

RDEPENDS_packagegroup-op-apps-flash_append = " host-fw"
```

## conf/machine/include/p10.inc
```bitbake
OBMC_MACHINE_FEATURES += 'op-fsi'
PREFERRED_PROVIDER_virtual/obmc-host-ctl = "p9-host-start"
```
